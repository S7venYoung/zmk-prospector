## Kconfig
```kconfig
menu "Prospector display themes"
rsource "display-themes/Kconfig"
endmenu

config ZMK_KEY_STATS
    bool "Physical key press statistics"
    depends on SETTINGS
    default n
config ZMK_KEY_STATS_SAVE_DEBOUNCE_SECONDS
    int "Key statistics save debounce"
    default 30
    depends on ZMK_KEY_STATS
config ZMK_KEY_STATS_SAVE_PRESS_INTERVAL
    int "Key statistics press save interval"
    default 50
    depends on ZMK_KEY_STATS
rsource "modules/zmk-feature-runtime-macro/Kconfig"
```

## boards/shields/corne/Kconfig.defconfig
```kconfig
if SHIELD_CORNE_DONGLE
config ZMK_KEYBOARD_NAME
    default "Corne DYA"
config ZMK_SPLIT
    default y
config ZMK_SPLIT_ROLE_CENTRAL
    default y
endif
```

## boards/shields/eyelash_sofle/Kconfig.shield
```kconfig
# Copyright (c) 2020 The ZMK Contributors
# SPDX-License-Identifier: MIT

config SHIELD_EYELASH_SOFLE_PROSPECTOR_DONGLE
    def_bool $(shields_list_contains,eyelash_sofle_prospector_dongle)

config SHIELD_EYELASH_SOFLE_PERIPHERAL_LEFT
    def_bool $(shields_list_contains,eyelash_sofle_peripheral_left)

config SHIELD_EYELASH_SOFLE_PERIPHERAL_RIGHT
    def_bool $(shields_list_contains,eyelash_sofle_peripheral_right)
```

## boards/shields/prospector_theme_codex_status/Kconfig.defconfig
```kconfig
if SHIELD_PROSPECTOR_THEME_CODEX_STATUS

config ZMK_PROSPECTOR_THEME_CODEX_STATUS
    default y

endif
```

## boards/shields/prospector_theme_codex_status/Kconfig.shield
```kconfig
config SHIELD_PROSPECTOR_THEME_CODEX_STATUS
    def_bool $(shields_list_contains,prospector_theme_codex_status)
```

## boards/shields/prospector_theme_field/Kconfig.shield
```kconfig
config SHIELD_PROSPECTOR_THEME_FIELD
    def_bool $(shields_list_contains,prospector_theme_field)
```

## boards/shields/prospector_theme_operator/Kconfig.shield
```kconfig
config SHIELD_PROSPECTOR_THEME_OPERATOR
    def_bool $(shields_list_contains,prospector_theme_operator)
```

## boards/shields/prospector_theme_radii/Kconfig.shield
```kconfig
config SHIELD_PROSPECTOR_THEME_RADII
    def_bool $(shields_list_contains,prospector_theme_radii)
```

## boards/shields/prospector_theme_retro_workstation/Kconfig.defconfig
```kconfig
if SHIELD_PROSPECTOR_THEME_RETRO_WORKSTATION

config ZMK_PROSPECTOR_THEME_RETRO_WORKSTATION
    default y

endif
```

## boards/shields/prospector_theme_retro_workstation/Kconfig.shield
```kconfig
config SHIELD_PROSPECTOR_THEME_RETRO_WORKSTATION
    def_bool $(shields_list_contains,prospector_theme_retro_workstation)
```

## boards/shields/prospector_theme_walle/Kconfig.defconfig
```kconfig
if SHIELD_PROSPECTOR_THEME_WALLE

config ZMK_PROSPECTOR_THEME_WALLE
    default y

endif
```

## boards/shields/prospector_theme_walle/Kconfig.shield
```kconfig
config SHIELD_PROSPECTOR_THEME_WALLE
    def_bool $(shields_list_contains,prospector_theme_walle)
```

## boards/shields/prospector_theme_weather_clock/Kconfig.defconfig
```kconfig
if SHIELD_PROSPECTOR_THEME_WEATHER_CLOCK

config ZMK_PROSPECTOR_THEME_WEATHER_CLOCK
    default y

endif
```

## boards/shields/prospector_theme_weather_clock/Kconfig.shield
```kconfig
config SHIELD_PROSPECTOR_THEME_WEATHER_CLOCK
    def_bool $(shields_list_contains,prospector_theme_weather_clock)
```

## boards/shields/prospector_theme_yads/Kconfig.shield
```kconfig
config SHIELD_PROSPECTOR_THEME_YADS
    def_bool $(shields_list_contains,prospector_theme_yads)
```

## boards/shields/scanner_display/Kconfig.shield
```kconfig
config SHIELD_SCANNER_DISPLAY
    def_bool $(shields_list_contains,scanner_display)
```

## config/west.yml
```yaml
manifest:
  version: 1.2
  defaults:
    remote: cormoran
    revision: main
  remotes:
    - name: cormoran
      url-base: https://github.com/cormoran
    - name: zmkfirmware
      url-base: https://github.com/zmkfirmware
    - name: gpeye
      url-base: https://github.com/GPeye
    - name: tokyo2006
      url-base: https://github.com/tokyo2006
    - name: carrefinho
      url-base: https://github.com/carrefinho
    - name: englmaxi
      url-base: https://github.com/englmaxi
    - name: s7venyoung
      url-base: https://github.com/S7venYoung
  projects:
    - name: mario-peripheral-animation
      remote: gpeye
      revision: main
    - name: zmk
      remote: cormoran
      revision: main+dya
      clone-depth: 1
      import:
        file: app/west.yml
    - name: zephyr
      remote: cormoran
      revision: v4.1.0+zmk-fixes+nrf-half-duplex-uart
      clone-depth: 1
      import:
        name-blocklist:
          - ci-tools
          - hal_altera
          - hal_cypress
          - hal_infineon
          - hal_microchip
          - hal_nxp
          - hal_openisa
          - hal_xtensa
          - hal_st
          - hal_ti
          - loramac-node
          - mcuboot
          - mcumgr
          - net-tools
          - openthread
          - edtt
          - trusted-firmware-m
          - chre
    - name: zmk-feature-custom-settings
      remote: cormoran
      revision: main
    - name: zmk-feature-device-info
      remote: cormoran
      revision: main
    - name: zmk-feature-runtime-combo
      remote: cormoran
      revision: main
      import: true
    - name: zmk-behavior-runtime-sensor-rotate
      remote: cormoran
      revision: main
    - name: zmk-module-ble-management
      remote: cormoran
      revision: main
    - name: zmk-module-battery-history
      remote: cormoran
      revision: main
    - name: zmk-module-settings-rpc
      remote: cormoran
      revision: main
    - name: zmk-module-runtime-input-processor
      remote: cormoran
      revision: main
    - name: prospector-zmk-module
      remote: carrefinho
      revision: core/zephyr-4-1
    - name: zmk-prospector-themes
      remote: s7venyoung
      repo-path: zmk-prospector
      revision: prospector-themes
      path: modules/zmk-prospector-themes
  self:
    path: config
```

## display-themes/Kconfig
```kconfig
config ZMK_PROSPECTOR_SCANNER_ORIGINAL
    bool "FIELD / OPERATOR / RADII / YADS / INDUSTRIAL / SEGMENT / ORBIT / SPLIT / MONO / TAPE / BLUEPRINT / TERMINAL on ms2"
    depends on $(shields_list_contains,prospector_ms2) && ZMK_DISPLAY
    help
      Restore the original scanner renderers on kblade ms2 using its existing
      local-state bridge. This does not turn the USB dongle into a BLE scanner.

config ZMK_PROSPECTOR_DYA_SETTINGS
    bool "DYA theme, palette and brightness settings"
    depends on ZMK_PROSPECTOR_SCANNER_ORIGINAL && ZMK_CUSTOM_SETTINGS && ZMK_STUDIO_RPC
    help
      Expose dongle_display_settings in DYA and apply changes from the LVGL
      thread. Requires the same main+dya core as the Prospector dongle project.

config ZMK_PROSPECTOR_BOOT_ANIMATION
    bool "One-shot CORNE scanner boot animation"
    depends on ZMK_PROSPECTOR_SCANNER_ORIGINAL && ZMK_PROSPECTOR_BROADCAST_SCANNER
    help
      Reveal CORNE with an amber scan beam, then fade into the saved theme.
      Uses LVGL timers without blocking USB, Studio RPC or BLE scanning.
```

## dts/bindings/cormoran,runtime-macro-default.yaml
```yaml
# Copyright (c) 2026 cormoran
# SPDX-License-Identifier: MIT

description: |
  Compile-time default macro, seeded into the runtime macro keyspace the
  first time settings load and no live macro already has this name - so it
  behaves like a factory value: visible and editable in the Web UI, and
  re-seeded (not overwritten) if a user Delete removes it, since the seed is
  never persisted itself. To remove a devicetree default permanently, delete
  this node instead. A macro's keyspace slot index is assigned when it is
  first created (not by devicetree order) - check the Web UI/RPC macro list
  after flashing to learn which slot number to bind in your keymap
  (`&rmacro <slot>`).

compatible: "cormoran,runtime-macro-default"

properties:
  macro-name:
    type: string
    description: >
      The macro's name (its keyspace key, "macro/<name>"). Defaults to the
      node name. Must be unique among runtime macros. (Named `macro-name`,
      not `name` - devicetree reserves a bare `name` property for legacy
      node-name mirroring and dtc rejects any other value for it.)
  text:
    type: string
    description: >
      ASCII text encoded as a compact packed key-tap sequence (same encoding
      the Web UI uses for consecutive plain-ASCII `&kp` taps). Encoded first,
      before `bindings`.
  bindings:
    type: phandle-array
    description: >
      ZMK-native macro step list, encoded after `text`. Supports
      &macro_tap / &macro_press / &macro_release to switch the mode applied
      to subsequent entries (initial mode is tap) and &macro_wait_time <ms>
      for an explicit delay step. Any other behavior binding is encoded
      using its behavior local ID, consistent with runtime macros written
      through the RPC. Plain-ASCII &kp taps in tap mode are packed the same
      way as `text`.
  wait-ms:
    type: int
    default: 0
    description: >
      Delay inserted between consecutive non-packed `bindings` steps
      (default 0 = none). Does not apply inside a packed key-tap run.
```

## hardware/prospector-zmk-module/boards/kblade/Kconfig.kblade
```kconfig
# Copyright (c) 2026 Pete Johanson
# SPDX-License-Identifier: MIT

config BOARD_KBLADE
    select SOC_NRF52840_QIAA
    select ZMK_BOARD_COMPAT if BOARD_KBLADE_NRF52840_ZMK
    imply RETAINED_MEM if BOARD_KBLADE_NRF52840_ZMK
    imply RETENTION if BOARD_KBLADE_NRF52840_ZMK
    imply RETENTION_BOOT_MODE if BOARD_KBLADE_NRF52840_ZMK
```

## hardware/prospector-zmk-module/boards/kblade/board.yml
```yaml
board:
  name: kblade
  full_name: KBlade nRF52840
  vendor: kblade
  socs:
    - name: nrf52840
      variants:
        - name: zmk
```

## hardware/prospector-zmk-module/boards/shields/prospector_ms/Kconfig.defconfig
```kconfig
# Prospector Scanner - Using display_test Kconfig.defconfig for debugging



config ZMK_KEYBOARD_NAME
    default "pro-rece2"

config ZMK_DISPLAY
    default n

config PROSPECTOR_SCANNER_TASK_WATCHDOG
    bool "Software watchdog that reboots the scanner if the display or core thread stops"
    default n
    select TASK_WDT
    help
      Arms a pure-software task watchdog (no hardware WDT, so firmware
      updates via the UF2 bootloader are unaffected). If the LVGL display
      thread or the system workqueue liveness work (s7789_update.c) stops
      running for 30s the device records the hang and reboots instead of
      sitting frozen. The record is reported in the boot log
      ("Recovered from crash").

# MIPI DBI for ST7789V (bool required for Zephyr 3.5.0 compatibility)
config MIPI_DBI
    bool
    default y

config SPI
    default y

# ST7789V pixel format
choice ST7789V_PIXEL_FORMAT
    default ST7789V_RGB565
endchoice

# LVGL basic settings
config LV_Z_VDB_SIZE
    default 100

config LV_DPI_DEF
    default 261

config LV_Z_BITS_PER_PIXEL
    default 16

choice LV_COLOR_DEPTH
    default LV_COLOR_DEPTH_16
endchoice

config LV_COLOR_16_SWAP
    default y

# Step 3: Use CUSTOM screen (like display_test)
choice ZMK_DISPLAY_STATUS_SCREEN
    default ZMK_DISPLAY_STATUS_SCREEN_CUSTOM
endchoice
```

## modules/zmk-feature-runtime-macro/Kconfig
```kconfig
config ZMK_RUNTIME_MACRO
    bool "Enable runtime macro feature"
    select ZMK_CUSTOM_SETTINGS
    select ZMK_BEHAVIOR_LOCAL_IDS

if ZMK_RUNTIME_MACRO

config ZMK_RUNTIME_MACRO_STUDIO_RPC
    bool "Enable runtime macro custom Studio RPC"
    depends on ZMK_STUDIO
    select ZMK_CUSTOM_SETTINGS_STUDIO_RPC

config ZMK_RUNTIME_MACRO_COUNT
    int "Maximum concurrently existing runtime macros"
    default 8
    range 1 16
    help
      Bounds the runtime_macros keyspace's max_entries: how many named
      macros can exist at once (not a byte budget - see
      ZMK_RUNTIME_MACRO_POOL_BYTES for that). Each keymap binding targets a
      macro by its keyspace slot index (0..COUNT-1); use the Web UI/RPC
      macro list to see which slot a given name is currently bound to.

config ZMK_RUNTIME_MACRO_NAME_MAX_LEN
    int "Maximum runtime macro name length (bytes, excluding NUL)"
    default 24
    range 1 32
    help
      A macro's name is its keyspace entry key (stored as "macro/<name>").
      This bounds the name portion only; the "macro/" prefix and NUL
      terminator are accounted for separately and must still fit within
      ZMK_CUSTOM_SETTINGS_KEY_MAX_LEN.

config ZMK_RUNTIME_MACRO_POOL_BYTES
    int "Shared runtime macro name+body pool size (bytes)"
    default 1024
    help
      Total bytes shared by every macro's opaque [name][body] keyspace
      entry. This is the only resident RAM added for large-macro support:
      an empty/short macro costs almost nothing, and the budget can be
      smaller than COUNT * MAX_BYTES worst case - it just means fewer
      simultaneous large macros. create()/write() return -ENOSPC (surfaced
      as "pool full" over RPC) once the budget is exhausted.

config ZMK_RUNTIME_MACRO_MAX_BYTES
    int "Maximum encoded bytes per runtime macro"
    default 256
    range ZMK_CUSTOM_SETTINGS_VALUE_MAX_SIZE ZMK_CUSTOM_SETTINGS_LARGE_VALUE_MAX_SIZE
    help
      Per-macro ceiling. Sizes the transient playback/RPC staging buffers, so
      keep it as small as your longest macro needs even if the pool is larger.

config ZMK_RUNTIME_MACRO_QUEUE_SIZE
    int "Maximum queued runtime macro actions"
    default 64
    range 1 128
    help
      A longer macro body (see ZMK_RUNTIME_MACRO_MAX_BYTES) can decode into
      more queued actions; raise this alongside MAX_BYTES if long macros hit
      this cap (playback aborts cleanly with a log warning if they do).

config ZMK_RUNTIME_MACRO_DEFAULT_TAP_MS
    int "Default tap duration for runtime macro taps"
    default 30
    range 0 10000

config ZMK_RUNTIME_MACRO_TEST
    bool "Enable runtime macro test setup"

config ZMK_RUNTIME_MACRO_DT_DEFAULTS_TEST
    bool "Enable devicetree default macro test setup"

endif
```
