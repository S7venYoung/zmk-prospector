## boards/shields/eyeslash_solfe/Kconfig.shield
```kconfig
# Copyright (c) 2020 The ZMK Contributors
# SPDX-License-Identifier: MIT

config SHIELD_EYESLASH_SOFLE_CENTRAL_DONGLE
    def_bool $(shields_list_contains,eyeslash_sofle_central_dongle)

config SHIELD_EYESLASH_SOFLE_PERIPHERAL_LEFT
    def_bool $(shields_list_contains,eyeslash_sofle_peripheral_left)

config SHIELD_EYESLASH_SOFLE_PERIPHERAL_RIGHT
    def_bool $(shields_list_contains,eyeslash_sofle_peripheral_right)
```

## dts/bindings/behaviors/cormoran,zmk-behavior-runtime-macro.yaml
```yaml
# Copyright (c) 2026 cormoran
# SPDX-License-Identifier: MIT

description: Runtime macro behavior

compatible: "cormoran,zmk-behavior-runtime-macro"

include: one_param.yaml
```
